## main/Kconfig.projbuild
```kconfig
menu "Snapclient Configuration"
    config SNAPCLIENT_USE_TIMEFILTER
        bool "Use Kalman Timefilter"
        default y
        help
            Use Kalman Timefilter for latency to server estimation. The non default is a median filter.
            
    config SNAPSERVER_USE_MDNS
        bool "Use mDNS"
        default y
        help
            Use mDNS to look for the snapserver to connect to on the local network.

    config SNAPCLIENT_CONNECT_IPV6
        bool "use IPv6"
        default n
        help
            Use IPv6 to connect to snapserver

    config SNAPSERVER_HOST
        string "Snapserver host"
        default "192.168.1.158"
        depends on !SNAPSERVER_USE_MDNS
        help
            Host (ip or name) of snapserver to connect to if mDNS is disabled or the mDNS resolution fails.

    config SNAPSERVER_PORT
        int "Snapserver port"
        default 1704
        depends on !SNAPSERVER_USE_MDNS
        help
            Port of the snapserver to connect to.

    config SNAPCLIENT_NAME
        string "snapclient name"
        default "ESP32-Caster"
        help
            Name of the client to register the snapserver.

	menu "HTTP Server Setting"
		config WEB_PORT
			int "User interface HTTP Server Port"
			default 8000
			help
				HTTP server port to use.

		config SNAPCLIENT_WEB_OTA
			bool "Enable OTA firmware upload via web interface"
			default y
			help
				Expose a /api/ota/upload endpoint and an OTA Update tab in the web UI.
				Disable to reduce firmware size or restrict update access.

		config SNAPCLIENT_WEB_OTA_PULL
			bool "Enable pull OTA (device fetches firmware from URL)"
			default y
			depends on SNAPCLIENT_WEB_OTA
			select MBEDTLS_CERTIFICATE_BUNDLE
			select MBEDTLS_CERTIFICATE_BUNDLE_DEFAULT_CMN
			help
				Expose a POST /api/ota/pull endpoint. The device downloads firmware
				directly from a URL, validates it (magic word + project name check),
				and flashes it. Disable to restrict OTA to local uploads only.

		config SNAPCLIENT_OTA_PULL_URL
			string "Default OTA manifest URL"
			default ""
			depends on SNAPCLIENT_WEB_OTA_PULL
			help
				Manifest URL pre-populated in the web UI. Leave empty for no default.
				Can always be overridden at runtime via the UI.

				Expected manifest JSON format:
				  {
				    "version":       "1.3.0",
				    "url":           "https://example.com/firmware.bin",
				    "sha256":        "abc123...",
				    "release_notes": "Fixed Wi-Fi reconnect bug"
				  }

				Fields: "url" is required; "version", "sha256", and
				"release_notes" are optional but recommended.
				"sha256" is logged and displayed in the UI; integrity is
				ultimately enforced by esp_ota_end() which re-reads the
				flashed partition and verifies the SHA-256 appended to
				every ESP-IDF image by the build system.
	endmenu

	config USE_SAMPLE_INSERTION
        bool "Use sample insertion"
        default y
        help
            There are two syncronization implementations.

            1. APLL tuning (ONLY use with DACs having MCLK input)
            2. sample insertion (duplicates a sample now and then to keep up sync)

            Both approaches have similar performance keeping clients in sync <= 500µs

endmenu
```
